## gsr/main/Kconfig.projbuild
```kconfig
menu "Project specific configuration"

config GSR_IN_GPIO
    int "GSR GPIO number"
	range 0 36
	default 36
	help
		GPIO number to read the analog value.

endmenu
```

## pot/main/Kconfig.projbuild
```kconfig
menu "Project specific configuration"

config POT_IN_GPIO
    int "Potentiometer GPIO number"
	range 0 36
	default 36
	help
		GPIO number to read the analog value.

endmenu
```
